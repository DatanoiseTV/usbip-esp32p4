## components/capture/Kconfig
```kconfig
menu "Packet Capture"
    config CAPTURE_ENABLED
        bool "Enable packet capture support"
        default y
    config CAPTURE_RING_BUF_SIZE
        int "Ring buffer size (bytes)"
        default 1048576
        depends on CAPTURE_ENABLED
    config CAPTURE_SNAPLEN
        int "Max payload bytes per packet"
        default 256
        depends on CAPTURE_ENABLED
endmenu
```

## main/Kconfig.projbuild
```kconfig
menu "USB/IP Server Configuration"

    config USBIP_TCP_PORT
        int "USB/IP TCP port"
        default 3240
        help
            TCP port number for the USB/IP server to listen on.

    config USBIP_MAX_DEVICES
        int "Maximum number of USB devices"
        default 8
        help
            Maximum number of USB devices that can be exported.

    config USBIP_MAX_CLIENTS
        int "Maximum number of concurrent clients"
        default 4
        help
            Maximum number of concurrent USB/IP client connections.

    config USBIP_HOSTNAME
        string "mDNS hostname"
        default "usbip-esp32p4"
        help
            Hostname used for mDNS advertisement.

endmenu
```

## sdkconfig.defaults
```kconfig
# USB/IP Server for ESP32-P4-Nano - sdkconfig defaults
# Target
CONFIG_IDF_TARGET="esp32p4"

# Chip revision: support ESP32-P4 rev <3.0 (rev 1.3 etc.)
# NOTE: rev <3.0 and >=3.0 are mutually exclusive due to hardware differences
CONFIG_ESP32P4_SELECTS_REV_LESS_V3=y
CONFIG_ESP32P4_REV_MIN_100=y

# CPU frequency
CONFIG_ESP_DEFAULT_CPU_FREQ_MHZ_360=y

# PSRAM
CONFIG_SPIRAM=y
CONFIG_SPIRAM_MODE_HEX=y
CONFIG_SPIRAM_SPEED_200M=y
CONFIG_SPIRAM_MALLOC_ALWAYSINTERNAL=4096
CONFIG_SPIRAM_MALLOC_RESERVE_INTERNAL=256000
CONFIG_SPIRAM_TRY_ALLOCATE_WIFI_LWIP=y

# USB Host
CONFIG_USB_OTG_SUPPORTED=y
CONFIG_USB_HOST_CONTROL_TRANSFER_MAX_SIZE=1024
CONFIG_USB_HOST_HUBS_SUPPORTED=y
CONFIG_USB_HOST_HUB_MULTI_LEVEL=y

# Ethernet
CONFIG_ETH_USE_ESP32_EMAC=y
CONFIG_ETH_DMA_RX_BUFFER_NUM=16
CONFIG_ETH_DMA_TX_BUFFER_NUM=16

# lwIP TCP tuning
CONFIG_LWIP_TCP_SND_BUF_DEFAULT=32768
CONFIG_LWIP_TCP_WND_DEFAULT=32768
CONFIG_LWIP_TCP_RECVMBOX_SIZE=32
CONFIG_LWIP_TCP_SND_QUEUELEN=64
CONFIG_LWIP_TCP_MSS=1460
CONFIG_LWIP_TCP_OVERSIZE_MSS=y
CONFIG_LWIP_TCPIP_RECVMBOX_SIZE=64
CONFIG_LWIP_TCP_QUEUE_OOSEQ=y
CONFIG_LWIP_ETHARP_TRUST_IP_SRC=y
CONFIG_LWIP_IRAM_OPTIMIZATION=y
CONFIG_LWIP_TCP_RTO_TIME=300
CONFIG_LWIP_TCPIP_TASK_PRIO=18
CONFIG_LWIP_TCPIP_TASK_STACK_SIZE=4096
CONFIG_LWIP_SO_REUSE=y
CONFIG_LWIP_TCP_KEEPALIVE_DEFAULT=y
CONFIG_LWIP_TCP_SACK_OUT=y
CONFIG_LWIP_NETIF_TX_SINGLE_PBUF=y

# mDNS
CONFIG_MDNS_MAX_SERVICES=4

# HTTP Server
CONFIG_HTTPD_MAX_REQ_HDR_LEN=1024
CONFIG_HTTPD_MAX_URI_LEN=512
CONFIG_HTTPD_WS_SUPPORT=y
CONFIG_HTTPD_QUEUE_SIZE=16

# NVS
CONFIG_NVS_ENCRYPTION=n

# FreeRTOS
CONFIG_FREERTOS_HZ=1000
CONFIG_FREERTOS_TIMER_TASK_STACK_DEPTH=3072

# esp_timer task needs more stack for WS broadcast JSON building
CONFIG_ESP_TIMER_TASK_STACK_SIZE=6144

# Watchdog
CONFIG_ESP_TASK_WDT_EN=y
CONFIG_ESP_TASK_WDT_TIMEOUT_S=10
CONFIG_ESP_TASK_WDT_CHECK_IDLE_TASK_CPU0=y
CONFIG_ESP_TASK_WDT_CHECK_IDLE_TASK_CPU1=y

# Flash size
CONFIG_ESPTOOLPY_FLASHSIZE_16MB=y

# Partition table
CONFIG_PARTITION_TABLE_CUSTOM=y
CONFIG_PARTITION_TABLE_CUSTOM_FILENAME="partitions.csv"

# Logging
CONFIG_LOG_DEFAULT_LEVEL_INFO=y
```
